/dts-v1/;
/plugin/;

/ {
    compatible = "brcm,bcm2835";

    fragment@0 {
        target = <&i2c_arm>;

        __overlay__ {
            status = "okay";
            #address-cells = <1>;
            #size-cells = <0>;

            aht10@38 {
                compatible = "learning,aht10-lab";
                reg = <0x38>;
                status = "okay";
            };
        };
    };
};
